## boards/shields/GeaconPolaris/Kconfig.defconfig
```kconfig
config ZMK_SPLIT
    default y

if SHIELD_Polaris_L_Base || SHIELD_Polaris_R_Base
    config RETAINED_MEM
        default y

    config RETENTION
        default y

    config RETENTION_BOOT_MODE
        default y

    config ZMK_CDC_ACM_BOOTLOADER_TRIGGER
        default y

    config ZMK_CDC_ACM_BOOTLOADER_TRIGGER_DELAY_MS
        default 100

    config ZMK_CDC_ACM_BOOTLOADER_TRIGGER_POLL_MS
        default 100
endif

if SHIELD_Polaris_L_Base
    config ZMK_KEYBOARD_NAME
        default "GeaconPolaris"

    config ZMK_SPLIT_ROLE_CENTRAL
        default y

    config ZMK_SPLIT_BLE_CENTRAL_PERIPHERALS
        default 1

    if ZMK_DISPLAY
        config I2C
            default y

        config SSD1306
            default y
    endif # ZMK_DISPLAY

    if LVGL
        config LV_Z_VDB_SIZE
            default 64

        config LV_DPI_DEF
            default 148

        config LV_Z_BITS_PER_PIXEL
            default 1

        choice LV_COLOR_DEPTH
            default LV_COLOR_DEPTH_1
        endchoice
    endif # LVGL
endif
```
